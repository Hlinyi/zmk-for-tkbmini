## config/boards/shields/tkbmini/Kconfig.defconfig
```kconfig
# Copyright (c) 2020 The ZMK Contributors
# SPDX-License-Identifier: MIT

if SHIELD_TKBMINI_LEFT

config ZMK_KEYBOARD_NAME
	default "tkbmini"

config ZMK_SPLIT_BLE_ROLE_CENTRAL
	default y

endif

if SHIELD_TKBMINI_LEFT || SHIELD_TKBMINI_RIGHT

config ZMK_SPLIT
	default y

endif
```

## config/boards/shields/tkbmini/Kconfig.shield
```kconfig
# Copyright (c) 2020 The ZMK Contributors
# SPDX-License-Identifier: MIT

config SHIELD_TKBMINI_LEFT
	def_bool $(shields_list_contains,tkbmini_left)

config SHIELD_TKBMINI_RIGHT
	def_bool $(shields_list_contains,tkbmini_right)
```

## config/west.yml
```yaml
manifest:
  remotes:
    - name: chase-hunten
      url-base: https://github.com/zmkfirmware
  projects:
    - name: zmk
      remote: petejohanson
      revision: feat/pointers-with-input-processors
      import: app/west.yml
  self:
    path: config
```
